## CMakeLists.txt
```
# SPDX-License-Identifier: Apache-2.0

cmake_minimum_required(VERSION 3.20.0)
find_package(Zephyr REQUIRED HINTS $ENV{ZEPHYR_BASE})
project(am13e230_tinielite_demo)
find_package(Python3 REQUIRED COMPONENTS Interpreter)

target_sources(app PRIVATE
  src/main.c
  src/app_aeabi_compat.c
  src/app_clock.c
  src/app_npu.c
  src/app_protocol.c
  src/app_uart.c
  src/app_watchdog.c
)

set(APP_MODEL "waveform_classifier" CACHE STRING "Model package under models/")
if(NOT APP_MODEL MATCHES "^[A-Za-z0-9_]+$")
  message(FATAL_ERROR "APP_MODEL must contain only letters, digits, and underscores")
endif()

set(MODEL_DIR "${CMAKE_CURRENT_SOURCE_DIR}/../models/${APP_MODEL}")
set(MODEL_MANIFEST "${MODEL_DIR}/model.json")
if(NOT EXISTS "${MODEL_MANIFEST}")
  message(FATAL_ERROR "Model package manifest not found: ${MODEL_MANIFEST}")
endif()

execute_process(
  COMMAND "${Python3_EXECUTABLE}" "${CMAKE_CURRENT_SOURCE_DIR}/../tools/model_package.py"
          "${MODEL_DIR}"
  RESULT_VARIABLE APP_MODEL_VALIDATION_RESULT
  OUTPUT_VARIABLE APP_MODEL_VALIDATION_OUTPUT
  ERROR_VARIABLE APP_MODEL_VALIDATION_ERROR
)
if(NOT APP_MODEL_VALIDATION_RESULT EQUAL 0)
  message(FATAL_ERROR
    "Invalid model package ${APP_MODEL}:\n${APP_MODEL_VALIDATION_OUTPUT}${APP_MODEL_VALIDATION_ERROR}")
endif()

file(READ "${MODEL_MANIFEST}" APP_MODEL_JSON)
string(JSON APP_MODEL_SCHEMA GET "${APP_MODEL_JSON}" schema_version)
if(NOT APP_MODEL_SCHEMA EQUAL 1)
  message(FATAL_ERROR "Unsupported model package schema: ${APP_MODEL_SCHEMA}")
endif()

string(JSON APP_MODEL_NAME GET "${APP_MODEL_JSON}" name)
string(JSON APP_MODEL_ID GET "${APP_MODEL_JSON}" model_id)
string(JSON APP_MODEL_INPUT_SIZE_BYTES GET "${APP_MODEL_JSON}" input size_bytes)
string(JSON APP_MODEL_OUTPUT_SIZE_BYTES GET "${APP_MODEL_JSON}" output size_bytes)
string(JSON APP_MODEL_INPUT_DTYPE GET "${APP_MODEL_JSON}" input dtype)
string(JSON APP_MODEL_OUTPUT_DTYPE GET "${APP_MODEL_JSON}" output dtype)
string(JSON APP_MODEL_IO_ALIGNMENT GET "${APP_MODEL_JSON}" io_alignment)
string(JSON APP_MODEL_LIBRARY_REL GET "${APP_MODEL_JSON}" artifacts library)
string(JSON APP_MODEL_HEADER_REL GET "${APP_MODEL_JSON}" artifacts header)
string(JSON APP_MODEL_ENTRY_SYMBOL GET "${APP_MODEL_JSON}" artifacts entry_symbol)
string(JSON APP_MODEL_REQUIRES_NPU GET "${APP_MODEL_JSON}" target requires_npu)

if(NOT APP_MODEL_NAME STREQUAL APP_MODEL)
  message(FATAL_ERROR
    "Model package directory '${APP_MODEL}' does not match manifest name '${APP_MODEL_NAME}'")
endif()

function(model_dtype_code output_variable dtype)
  if(dtype STREQUAL "int8")
    set(code 1)
  elseif(dtype STREQUAL "uint8")
    set(code 2)
  elseif(dtype STREQUAL "int16")
    set(code 3)
  elseif(dtype STREQUAL "float32")
    set(code 4)
  else()
    message(FATAL_ERROR "Unsupported model dtype: ${dtype}")
  endif()
  set(${output_variable} ${code} PARENT_SCOPE)
endfunction()

model_dtype_code(APP_MODEL_INPUT_DTYPE_CODE "${APP_MODEL_INPUT_DTYPE}")
model_dtype_code(APP_MODEL_OUTPUT_DTYPE_CODE "${APP_MODEL_OUTPUT_DTYPE}")
if(APP_MODEL_REQUIRES_NPU)
  set(APP_MODEL_CAPABILITY_FLAGS 1)
else()
  message(FATAL_ERROR "The current inference engine requires a TINIElite NPU model")
endif()

foreach(required_path
    "${MODEL_DIR}/${APP_MODEL_LIBRARY_REL}"
    "${MODEL_DIR}/${APP_MODEL_HEADER_REL}")
  if(NOT EXISTS "${required_path}")
    message(FATAL_ERROR "Model package file not found: ${required_path}")
  endif()
endforeach()

configure_file(
  src/app_model_config.h.in
  ${CMAKE_CURRENT_BINARY_DIR}/generated/app_model_config.h
  @ONLY
)

set(APP_MODEL_ADAPTER "${CMAKE_CURRENT_BINARY_DIR}/generated/model_adapter.c")
execute_process(
  COMMAND "${Python3_EXECUTABLE}"
          "${CMAKE_CURRENT_SOURCE_DIR}/../tools/generate_model_adapter.py"
          "${MODEL_DIR}" "${APP_MODEL_ADAPTER}"
  RESULT_VARIABLE APP_MODEL_GENERATION_RESULT
  OUTPUT_VARIABLE APP_MODEL_GENERATION_OUTPUT
  ERROR_VARIABLE APP_MODEL_GENERATION_ERROR
)
if(NOT APP_MODEL_GENERATION_RESULT EQUAL 0)
  message(FATAL_ERROR
    "Could not generate adapter for ${APP_MODEL}:\n"
    "${APP_MODEL_GENERATION_OUTPUT}${APP_MODEL_GENERATION_ERROR}")
endif()
set_source_files_properties("${APP_MODEL_ADAPTER}" PROPERTIES GENERATED TRUE)
set_property(DIRECTORY APPEND PROPERTY CMAKE_CONFIGURE_DEPENDS
  "${MODEL_MANIFEST}"
  "${MODEL_DIR}/${APP_MODEL_HEADER_REL}"
  "${CMAKE_CURRENT_SOURCE_DIR}/../tools/model_package.py"
  "${CMAKE_CURRENT_SOURCE_DIR}/../tools/generate_model_adapter.py"
)

get_filename_component(APP_MODEL_HEADER_DIR "${MODEL_DIR}/${APP_MODEL_HEADER_REL}" DIRECTORY)
target_sources(app PRIVATE "${APP_MODEL_ADAPTER}")
target_include_directories(app PRIVATE
  "${CMAKE_CURRENT_SOURCE_DIR}/src"
  "${CMAKE_CURRENT_BINARY_DIR}/generated"
)
target_include_directories(app SYSTEM PRIVATE "${APP_MODEL_HEADER_DIR}")
target_link_libraries(app PRIVATE "${MODEL_DIR}/${APP_MODEL_LIBRARY_REL}")
target_link_options(zephyr_interface INTERFACE "-Wl,-u,${APP_MODEL_ENTRY_SYMBOL}")

message(STATUS
  "Selected model ${APP_MODEL_NAME}: input=${APP_MODEL_INPUT_SIZE_BYTES}B/${APP_MODEL_INPUT_DTYPE}, "
  "output=${APP_MODEL_OUTPUT_SIZE_BYTES}B/${APP_MODEL_OUTPUT_DTYPE}")
message(STATUS "Generated model adapter: ${APP_MODEL_ADAPTER}")
```

## Kconfig
```
# SPDX-License-Identifier: Apache-2.0

mainmenu "AM13E230 TINIElite inference demo"

source "Kconfig.zephyr"

config APP_NPU_FAULT_INJECTION
	bool "Enable the UART-triggered NPU timeout recovery test"
	help
	  Allow the host regression client to deliberately wait for a completion
	  without starting TINIElite. The firmware reports the expected timeout and
	  performs a full system reset. Disable this diagnostic interface in a
	  deployed product.

config APP_WATCHDOG_FAULT_INJECTION
	bool "Enable the UART-triggered hardware watchdog recovery test"
	help
	  Allow the host regression client to deliberately stop servicing WWDT0.
	  The host verifies that the independent watchdog resets the board and that
	  the latched reset cause identifies WWDT0. Disable this diagnostic
	  interface in a deployed product.
```

## prj.conf
```kconfig
CONFIG_SERIAL=y
CONFIG_CONSOLE=y
CONFIG_UART_CONSOLE=y
CONFIG_PRINTK=y
CONFIG_REBOOT=y

CONFIG_MAIN_STACK_SIZE=32768
CONFIG_BUILD_OUTPUT_HEX=y
CONFIG_TINYENGINE_AM13E230X=y
CONFIG_APP_NPU_FAULT_INJECTION=y
CONFIG_APP_WATCHDOG_FAULT_INJECTION=y
```

## app.overlay
```dts
&tinyengine {
	status = "okay";
};

&wwdt0 {
	status = "okay";
};
```

## src/main.c
```c
/* SPDX-License-Identifier: Apache-2.0 */

#include <errno.h>
#include <stdint.h>

#include <zephyr/kernel.h>
#include <zephyr/sys/printk.h>
#include <zephyr/sys/reboot.h>

#include "app_clock.h"
#include "app_model.h"
#include "app_npu.h"
#include "app_uart.h"
#include "app_watchdog.h"

static uint8_t model_input[APP_MODEL_INPUT_SIZE_BYTES] __aligned(APP_MODEL_IO_ALIGNMENT);
static uint8_t model_output[APP_MODEL_OUTPUT_SIZE_BYTES] __aligned(APP_MODEL_IO_ALIGNMENT);

static void reboot_after_error(void)
{
	/* uart_poll_out() may return while the final byte is still shifting. */
	k_busy_wait(10000U);
	sys_reboot(SYS_REBOOT_COLD);
}

int main(void)
{
	struct app_npu_metrics metrics;
	struct app_uart_request request;
	struct app_clock_status clock_status;
	struct app_watchdog_status watchdog_status;
	int ret;

	printk("\n*** AM13E230 Zephyr TINIElite demo ***\n");
	printk("Execution mode: interrupt-driven NPU completion, framed protocol v3\n");
	printk("Model: %s (id 0x%08x, input %u B, output %u B)\n", APP_MODEL_NAME, APP_MODEL_ID,
	       APP_MODEL_INPUT_SIZE_BYTES, APP_MODEL_OUTPUT_SIZE_BYTES);

	ret = app_uart_init();
	if (ret != 0) {
		printk("FATAL: UART initialization failed (%d)\n", ret);
		return ret;
	}

	ret = app_watchdog_init();
	if (ret != 0) {
		printk("FATAL: hardware watchdog initialization failed (%d)\n", ret);
		return ret;
	}

	ret = app_npu_init();
	if (ret != 0) {
		printk("FATAL: NPU initialization failed (%d)\n", ret);
		return ret;
	}

	for (;;) {
		ret = app_watchdog_feed();
		if (ret != 0) {
			printk("FATAL: hardware watchdog feed failed (%d)\n", ret);
			return ret;
		}
		ret = app_uart_receive_request(model_input, sizeof(model_input), &request);
		if (ret != 0) {
			continue;
		}
		(void)app_watchdog_feed();
		if (request.type == APP_UART_FRAME_CLOCK_REQUEST) {
			app_clock_read_status(&clock_status);
			ret = app_uart_send_clock_status(request.sequence, &clock_status);
			if (ret != 0) {
				app_uart_send_error(request.sequence, APP_UART_ERROR_INTERNAL, ret);
			}
			continue;
		}
		if (request.type == APP_UART_FRAME_WATCHDOG_STATUS_REQUEST) {
			app_watchdog_read_status(&watchdog_status);
			ret = app_uart_send_watchdog_status(request.sequence, &watchdog_status);
			if (ret != 0) {
				app_uart_send_error(request.sequence, APP_UART_ERROR_INTERNAL, ret);
			}
			continue;
		}
		if (request.type == APP_UART_FRAME_WATCHDOG_STALL_REQUEST) {
			app_watchdog_test_stall();
		}
		if (request.type == APP_UART_FRAME_NPU_STALL_REQUEST) {
			ret = app_npu_test_stall_timeout();
			app_uart_send_error(request.sequence,
					    ret == -ETIMEDOUT ? APP_UART_ERROR_INFERENCE
							      : APP_UART_ERROR_INTERNAL,
					    ret);
			reboot_after_error();
			continue;
		}

		ret = app_npu_run_inference(model_input, model_output, &metrics);
		if (ret != 0) {
			app_uart_send_error(request.sequence, APP_UART_ERROR_INFERENCE, ret);
			if (ret == -ETIMEDOUT) {
				reboot_after_error();
			}
			continue;
		}

		ret = app_uart_send_result(request.sequence, model_output, sizeof(model_output),
					   &metrics);
		if (ret != 0) {
			app_uart_send_error(request.sequence, APP_UART_ERROR_INTERNAL, ret);
		}
	}

	return 0;
}
```

## src/app_aeabi_compat.c
```c
/* SPDX-License-Identifier: Apache-2.0 */

#include <stddef.h>

/*
 * TI Arm Clang may emit this standard Arm EABI helper when lowering an
 * aligned zero-fill. Zephyr's minimal libc configuration does not provide
 * the symbol, so keep a small freestanding implementation in the app.
 */
void __aeabi_memclr4(void *destination, size_t byte_count)
{
	volatile unsigned char *cursor = destination;

	while (byte_count != 0U) {
		*cursor = 0U;
		cursor++;
		byte_count--;
	}
}
```

## src/app_clock.c
```c
/* SPDX-License-Identifier: Apache-2.0 */

#include "app_clock.h"

#include <stddef.h>
#include <stdint.h>

#include <zephyr/arch/cpu.h>
#include <zephyr/devicetree.h>
#include <zephyr/sys/sys_io.h>

#define SYSCTL_NODE DT_NODELABEL(sysctl)
#define UART_NODE   DT_CHOSEN(zephyr_console)

#define SYSCTL_BASE      DT_REG_ADDR_BY_NAME(SYSCTL_NODE, sysctl)
#define FRI_BASE         DT_REG_ADDR_BY_NAME(SYSCTL_NODE, fri)
#define EXPECTED_MCLK_HZ DT_PROP(DT_NODELABEL(cpu0), clock_frequency)
#define UART_CLOCK_HZ    DT_PROP(DT_PHANDLE(UART_NODE, clocks), clock_frequency)
#define HFCLK_HZ         DT_PROP(SYSCTL_NODE, ti_hfclk_frequency)
#define SYSOSC_HZ        DT_PROP(SYSCTL_NODE, ti_sysosc_frequency)

#define MCLKCFG_OFFSET       0x1104U
#define HSCLKEN_OFFSET       0x1108U
#define HSCLKCFG_OFFSET      0x110CU
#define PLLCFG0_OFFSET       0x1120U
#define PLLCFG1_OFFSET       0x1124U
#define GENCLKEN_OFFSET      0x113CU
#define CLKSTATUS_OFFSET     0x1204U
#define FLASH_CONTROL_OFFSET 0x1000U

#define MCLKCFG_USE_HSCLK         (1U << 16)
#define HSCLKEN_PLL_ENABLE        (1U << 8)
#define HSCLKCFG_USE_HFCLK        (1U << 0)
#define PLLCFG0_REF_HFCLK         (1U << 0)
#define PLLCFG0_CLK0_ENABLE       (1U << 4)
#define GENCLKEN_DIV_ENABLE       (1U << 11)
#define CLKSTATUS_HF_GOOD         (1U << 8)
#define CLKSTATUS_PLL_GOOD        (1U << 9)
#define CLKSTATUS_MCLK_HS         (1U << 4)
#define CLKSTATUS_HS_SOURCE_HFCLK (1U << 16)
#define CLKSTATUS_HS_DEAD         (1U << 20)
#define CLKSTATUS_HS_GOOD         (1U << 21)

#define FLASH_WS0_MODE           (1U << 0)
#define FLASH_RWAIT_SHIFT        8U
#define FLASH_RWAIT_MASK         0xFU
#define FLASH_200MHZ_WAIT_STATES 3U

static uint32_t pll_output_hz(uint32_t pllcfg0, uint32_t pllcfg1)
{
	uint32_t reference_hz = (pllcfg0 & PLLCFG0_REF_HFCLK) != 0U ? HFCLK_HZ : SYSOSC_HZ;
	uint32_t pdiv = 1U << (pllcfg1 & 0x3U);
	uint32_t qdiv = ((pllcfg1 >> 8) & 0x7FU) + 1U;
	uint32_t rdiv = ((((pllcfg0 >> 8) & 0xFU) + 1U) * 2U);

	return (reference_hz / pdiv) * qdiv / rdiv;
}

static uint32_t active_mclk_hz(const struct app_clock_status *status)
{
	uint32_t frequency;

	if ((status->clkstatus & CLKSTATUS_MCLK_HS) == 0U) {
		return (status->clkstatus & 0x3U) == 1U ? 4000000U : SYSOSC_HZ;
	}

	if ((status->clkstatus & CLKSTATUS_HS_SOURCE_HFCLK) != 0U) {
		return HFCLK_HZ;
	}

	frequency = pll_output_hz(status->pllcfg0, status->pllcfg1);
	if ((status->genclken & GENCLKEN_DIV_ENABLE) != 0U) {
		frequency /= ((((status->genclken >> 8) & 0x7U) + 1U) * 2U);
	}
	return frequency;
}

void app_clock_read_status(struct app_clock_status *status)
{
	uint32_t flash_wait_states;

	if (status == NULL) {
		return;
	}

	status->expected_mclk_hz = EXPECTED_MCLK_HZ;
	status->uart_clock_hz = UART_CLOCK_HZ;
	status->mclkcfg = sys_read32(SYSCTL_BASE + MCLKCFG_OFFSET);
	status->hsclken = sys_read32(SYSCTL_BASE + HSCLKEN_OFFSET);
	status->hsclkcfg = sys_read32(SYSCTL_BASE + HSCLKCFG_OFFSET);
	status->pllcfg0 = sys_read32(SYSCTL_BASE + PLLCFG0_OFFSET);
	status->pllcfg1 = sys_read32(SYSCTL_BASE + PLLCFG1_OFFSET);
	status->genclken = sys_read32(SYSCTL_BASE + GENCLKEN_OFFSET);
	status->clkstatus = sys_read32(SYSCTL_BASE + CLKSTATUS_OFFSET);
	status->flash_control = sys_read32(FRI_BASE + FLASH_CONTROL_OFFSET);
	status->derived_mclk_hz = active_mclk_hz(status);
	status->validation_flags = 0U;

	if (((status->mclkcfg & MCLKCFG_USE_HSCLK) != 0U) &&
	    ((status->clkstatus & CLKSTATUS_MCLK_HS) != 0U)) {
		status->validation_flags |= APP_CLOCK_VALID_MCLK_SOURCE;
	}
	if (((status->clkstatus & CLKSTATUS_HS_GOOD) != 0U) &&
	    ((status->clkstatus & CLKSTATUS_HS_DEAD) == 0U)) {
		status->validation_flags |= APP_CLOCK_VALID_HSCLK;
	}
	if ((status->hsclkcfg & HSCLKCFG_USE_HFCLK) != 0U) {
		if ((status->clkstatus & CLKSTATUS_HF_GOOD) != 0U) {
			status->validation_flags |= APP_CLOCK_VALID_PLL;
		}
	} else if (((status->hsclken & HSCLKEN_PLL_ENABLE) != 0U) &&
		   ((status->pllcfg0 & PLLCFG0_CLK0_ENABLE) != 0U) &&
		   ((status->clkstatus & CLKSTATUS_PLL_GOOD) != 0U)) {
		status->validation_flags |= APP_CLOCK_VALID_PLL;
	}
	if (status->derived_mclk_hz == status->expected_mclk_hz) {
		status->validation_flags |= APP_CLOCK_VALID_FREQUENCY;
	}

	flash_wait_states =
		(status->flash_control & FLASH_WS0_MODE) != 0U
			? 0U
			: (status->flash_control >> FLASH_RWAIT_SHIFT) & FLASH_RWAIT_MASK;
	if ((status->expected_mclk_hz <= 50000000U) ||
	    (flash_wait_states >= FLASH_200MHZ_WAIT_STATES)) {
		status->validation_flags |= APP_CLOCK_VALID_FLASH_WAIT_STATES;
	}
}

bool app_clock_status_is_valid(const struct app_clock_status *status)
{
	return (status != NULL) && ((status->validation_flags & APP_CLOCK_VALIDATION_REQUIRED) ==
				    APP_CLOCK_VALIDATION_REQUIRED);
}
```

## src/app_clock.h
```c
/* SPDX-License-Identifier: Apache-2.0 */

#ifndef APP_CLOCK_H_
#define APP_CLOCK_H_

#include <stdbool.h>
#include <stdint.h>

struct app_clock_status {
	uint32_t expected_mclk_hz;
	uint32_t derived_mclk_hz;
	uint32_t uart_clock_hz;
	uint32_t mclkcfg;
	uint32_t hsclken;
	uint32_t hsclkcfg;
	uint32_t pllcfg0;
	uint32_t pllcfg1;
	uint32_t genclken;
	uint32_t clkstatus;
	uint32_t flash_control;
	uint32_t validation_flags;
};

enum app_clock_validation_flag {
	APP_CLOCK_VALID_MCLK_SOURCE = (1U << 0),
	APP_CLOCK_VALID_HSCLK = (1U << 1),
	APP_CLOCK_VALID_PLL = (1U << 2),
	APP_CLOCK_VALID_FREQUENCY = (1U << 3),
	APP_CLOCK_VALID_FLASH_WAIT_STATES = (1U << 4),
};

#define APP_CLOCK_VALIDATION_REQUIRED                                                              \
	(APP_CLOCK_VALID_MCLK_SOURCE | APP_CLOCK_VALID_HSCLK | APP_CLOCK_VALID_PLL |               \
	 APP_CLOCK_VALID_FREQUENCY | APP_CLOCK_VALID_FLASH_WAIT_STATES)

void app_clock_read_status(struct app_clock_status *status);
bool app_clock_status_is_valid(const struct app_clock_status *status);

#endif /* APP_CLOCK_H_ */
```

## src/app_model.h
```c
/* SPDX-License-Identifier: Apache-2.0 */

#ifndef APP_MODEL_H_
#define APP_MODEL_H_

#include <stdbool.h>
#include <stdint.h>

#include "app_model_config.h"

enum app_model_dtype {
	APP_MODEL_DTYPE_INT8 = 1,
	APP_MODEL_DTYPE_UINT8 = 2,
	APP_MODEL_DTYPE_INT16 = 3,
	APP_MODEL_DTYPE_FLOAT32 = 4,
};

#define APP_MODEL_CAPABILITY_REQUIRES_NPU 0x0001U

void app_model_reset(void);
int32_t app_model_run(void *input, void *output);
bool app_model_is_finished(void);
void app_model_continue(void);

#endif /* APP_MODEL_H_ */
```

## src/app_npu.c
```c
/* SPDX-License-Identifier: Apache-2.0 */

#include "app_npu.h"
#include "app_model.h"

#include <errno.h>
#include <stdint.h>

#include <zephyr/device.h>
#include <zephyr/devicetree.h>
#include <zephyr/drivers/tinyengine.h>
#include <zephyr/kernel.h>
#define TINYENGINE_NODE      DT_COMPAT_GET_ANY_STATUS_OKAY(ti_am13e230x_tinyengine)
#define NPU_STAGE_TIMEOUT_MS 100U

static const struct device *const npu_dev = DEVICE_DT_GET(TINYENGINE_NODE);

int app_npu_init(void)
{
	return device_is_ready(npu_dev) ? 0 : -ENODEV;
}

int app_npu_run_inference(void *input, void *output, struct app_npu_metrics *metrics)
{
	uint32_t total_start;
	uint32_t total_us;
	uint32_t accelerator_us = 0U;
	uint32_t runtime_us = 0U;
	uint32_t runtime_start;
	uint32_t interrupt_start;
	uint32_t spurious_start;
	int32_t run_status;
	int ret;

	if ((input == NULL) || (output == NULL) || (metrics == NULL)) {
		return -EINVAL;
	}

	app_model_reset();
	ret = tinyengine_prepare_inference();
	if (ret != 0) {
		return ret;
	}
	interrupt_start = tinyengine_completion_count();
	spurious_start = tinyengine_spurious_count();
	total_start = k_cycle_get_32();

	runtime_start = k_cycle_get_32();
	run_status = app_model_run(input, output);
	runtime_us += k_cyc_to_us_floor32(k_cycle_get_32() - runtime_start);
	if (run_status != 0) {
		return -EIO;
	}

	while (!app_model_is_finished()) {
		uint32_t accelerator_start = k_cycle_get_32();

		ret = tinyengine_wait_for_completion(K_MSEC(NPU_STAGE_TIMEOUT_MS));
		if (ret != 0) {
			return ret == -EAGAIN ? -ETIMEDOUT : ret;
		}
		accelerator_us += k_cyc_to_us_floor32(k_cycle_get_32() - accelerator_start);

		/* Continue the generated runtime after one hardware stage completes. */
		runtime_start = k_cycle_get_32();
		app_model_continue();
		runtime_us += k_cyc_to_us_floor32(k_cycle_get_32() - runtime_start);
	}
	total_us = k_cyc_to_us_floor32(k_cycle_get_32() - total_start);

	metrics->accelerator_us = accelerator_us;
	metrics->runtime_us = runtime_us;
	metrics->total_us = total_us;
	metrics->npu_interrupts = tinyengine_completion_count() - interrupt_start;
	metrics->npu_spurious_interrupts = tinyengine_spurious_count() - spurious_start;
	if ((metrics->npu_interrupts == 0U) || (metrics->npu_spurious_interrupts != 0U)) {
		return -EIO;
	}

	return 0;
}

int app_npu_test_stall_timeout(void)
{
	int ret = tinyengine_prepare_inference();

	if (ret != 0) {
		return ret;
	}

	/* Deliberately do not start TINIElite: exercise the real bounded wait. */
	ret = tinyengine_wait_for_completion(K_MSEC(NPU_STAGE_TIMEOUT_MS));
	if (ret == -EAGAIN) {
		return -ETIMEDOUT;
	}
	return ret == 0 ? -EIO : ret;
}
```

## src/app_npu.h
```c
/* SPDX-License-Identifier: Apache-2.0 */

#ifndef APP_NPU_H_
#define APP_NPU_H_

#include <stdint.h>

struct app_npu_metrics {
	uint32_t accelerator_us;
	uint32_t runtime_us;
	uint32_t total_us;
	uint32_t npu_interrupts;
	uint32_t npu_spurious_interrupts;
};

int app_npu_init(void);
int app_npu_run_inference(void *input, void *output, struct app_npu_metrics *metrics);
int app_npu_test_stall_timeout(void);

#endif /* APP_NPU_H_ */
```

## src/app_protocol.c
```c
/* SPDX-License-Identifier: Apache-2.0 */

#include "app_protocol.h"

#include <limits.h>
#include <stddef.h>

#define FRAME_HEADER_SIZE 8U

static uint32_t crc32_update(uint32_t crc, uint8_t value)
{
	crc ^= value;
	for (uint32_t bit = 0U; bit < 8U; ++bit) {
		crc = (crc >> 1) ^ ((crc & 1U) != 0U ? 0xEDB88320U : 0U);
	}
	return crc;
}

uint32_t app_protocol_frame_crc32(const uint8_t *header, const uint8_t *payload, uint16_t length)
{
	uint32_t crc = UINT32_MAX;

	for (uint32_t i = 2U; i < FRAME_HEADER_SIZE; ++i) {
		crc = crc32_update(crc, header[i]);
	}
	for (uint32_t i = 0U; i < length; ++i) {
		crc = crc32_update(crc, payload[i]);
	}
	return ~crc;
}

enum app_uart_error_code app_protocol_validate_request(uint8_t version, uint8_t type,
						       uint16_t length, uint16_t input_size,
						       bool allow_npu_fault,
						       bool allow_watchdog_fault)
{
	if (version != APP_UART_PROTOCOL_VERSION) {
		return APP_UART_ERROR_VERSION;
	}

	switch (type) {
	case APP_UART_FRAME_INFER_REQUEST:
		return length == input_size ? APP_UART_ERROR_NONE : APP_UART_ERROR_LENGTH;
	case APP_UART_FRAME_CLOCK_REQUEST:
	case APP_UART_FRAME_WATCHDOG_STATUS_REQUEST:
		return length == 0U ? APP_UART_ERROR_NONE : APP_UART_ERROR_LENGTH;
	case APP_UART_FRAME_NPU_STALL_REQUEST:
		if (!allow_npu_fault) {
			return APP_UART_ERROR_TYPE;
		}
		return length == 0U ? APP_UART_ERROR_NONE : APP_UART_ERROR_LENGTH;
	case APP_UART_FRAME_WATCHDOG_STALL_REQUEST:
		if (!allow_watchdog_fault) {
			return APP_UART_ERROR_TYPE;
		}
		return length == 0U ? APP_UART_ERROR_NONE : APP_UART_ERROR_LENGTH;
	default:
		return APP_UART_ERROR_TYPE;
	}
}
```

## src/app_protocol.h
```c
/* SPDX-License-Identifier: Apache-2.0 */

#ifndef APP_PROTOCOL_H_
#define APP_PROTOCOL_H_

#include <stdbool.h>
#include <stdint.h>

#define APP_UART_FRAME_MAGIC_0    0x5AU
#define APP_UART_FRAME_MAGIC_1    0xA5U
#define APP_UART_PROTOCOL_VERSION 3U

enum app_uart_frame_type {
	APP_UART_FRAME_INFER_REQUEST = 0x01,
	APP_UART_FRAME_CLOCK_REQUEST = 0x02,
	APP_UART_FRAME_NPU_STALL_REQUEST = 0x03,
	APP_UART_FRAME_WATCHDOG_STALL_REQUEST = 0x04,
	APP_UART_FRAME_WATCHDOG_STATUS_REQUEST = 0x05,
	APP_UART_FRAME_READY = 0x80,
	APP_UART_FRAME_ACK = 0x81,
	APP_UART_FRAME_RESULT = 0x82,
	APP_UART_FRAME_CLOCK_STATUS = 0x83,
	APP_UART_FRAME_WATCHDOG_STATUS = 0x84,
	APP_UART_FRAME_ERROR = 0xFF,
};

enum app_uart_error_code {
	APP_UART_ERROR_NONE = 0,
	APP_UART_ERROR_TIMEOUT = 1,
	APP_UART_ERROR_VERSION = 2,
	APP_UART_ERROR_TYPE = 3,
	APP_UART_ERROR_LENGTH = 4,
	APP_UART_ERROR_CRC = 5,
	APP_UART_ERROR_INFERENCE = 6,
	APP_UART_ERROR_INTERNAL = 7,
	APP_UART_ERROR_TRANSPORT = 8,
};

uint32_t app_protocol_frame_crc32(const uint8_t *header, const uint8_t *payload, uint16_t length);

enum app_uart_error_code app_protocol_validate_request(uint8_t version, uint8_t type,
						       uint16_t length, uint16_t input_size,
						       bool allow_npu_fault,
						       bool allow_watchdog_fault);

#endif /* APP_PROTOCOL_H_ */
```

## src/app_uart.c
```c
/* SPDX-License-Identifier: Apache-2.0 */

#include "app_uart.h"
#include "app_model.h"

#include <errno.h>
#include <limits.h>
#include <stdbool.h>
#include <stddef.h>
#include <stdint.h>
#include <string.h>

#include <zephyr/device.h>
#include <zephyr/drivers/uart.h>
#include <zephyr/kernel.h>

#define UART_NODE                    DT_CHOSEN(zephyr_console)
#define FRAME_HEADER_SIZE            8U
#define FRAME_CRC_SIZE               4U
#define READY_PAYLOAD_SIZE           12U
#define RESULT_METRICS_SIZE          20U
#define RESULT_PAYLOAD_SIZE          (APP_MODEL_OUTPUT_SIZE_BYTES + RESULT_METRICS_SIZE)
#define CLOCK_STATUS_WORDS           12U
#define CLOCK_STATUS_PAYLOAD_SIZE    (CLOCK_STATUS_WORDS * sizeof(uint32_t))
#define WATCHDOG_STATUS_WORDS        3U
#define WATCHDOG_STATUS_PAYLOAD_SIZE (WATCHDOG_STATUS_WORDS * sizeof(uint32_t))
#define FRAME_MODEL_MAX_PAYLOAD_SIZE                                                               \
	((APP_MODEL_INPUT_SIZE_BYTES > RESULT_PAYLOAD_SIZE) ? APP_MODEL_INPUT_SIZE_BYTES           \
							    : RESULT_PAYLOAD_SIZE)
#define FRAME_MAX_PAYLOAD_SIZE                                                                     \
	((FRAME_MODEL_MAX_PAYLOAD_SIZE > CLOCK_STATUS_PAYLOAD_SIZE) ? FRAME_MODEL_MAX_PAYLOAD_SIZE \
								    : CLOCK_STATUS_PAYLOAD_SIZE)

static const struct device *const uart_dev = DEVICE_DT_GET(UART_NODE);

static uint16_t decode_le16(const uint8_t *value)
{
	return (uint16_t)value[0] | ((uint16_t)value[1] << 8);
}

static uint32_t decode_le32(const uint8_t *value)
{
	return (uint32_t)value[0] | ((uint32_t)value[1] << 8) | ((uint32_t)value[2] << 16) |
	       ((uint32_t)value[3] << 24);
}

static void encode_le16(uint8_t *destination, uint16_t value)
{
	destination[0] = (uint8_t)value;
	destination[1] = (uint8_t)(value >> 8);
}

static void encode_le32(uint8_t *destination, uint32_t value)
{
	destination[0] = (uint8_t)value;
	destination[1] = (uint8_t)(value >> 8);
	destination[2] = (uint8_t)(value >> 16);
	destination[3] = (uint8_t)(value >> 24);
}

static int read_byte_until(uint8_t *value, uint32_t start, uint32_t timeout_ms)
{
	for (;;) {
		if (uart_err_check(uart_dev) != 0) {
			return -EIO;
		}
		if (uart_poll_in(uart_dev, value) == 0) {
			return 0;
		}
		if ((k_uptime_get_32() - start) >= timeout_ms) {
			return -ETIMEDOUT;
		}
		k_busy_wait(50);
	}
}

static int read_exact(uint8_t *data, uint32_t size, uint32_t start, uint32_t timeout_ms)
{
	for (uint32_t i = 0U; i < size; ++i) {
		int ret = read_byte_until(&data[i], start, timeout_ms);

		if (ret != 0) {
			return ret;
		}
	}
	return 0;
}

static int read_magic(uint32_t start)
{
	bool first_seen = false;
	uint8_t byte;

	for (;;) {
		int ret = read_byte_until(&byte, start, APP_UART_RX_TIMEOUT_MS);

		if (ret != 0) {
			return ret;
		}
		if (first_seen && (byte == APP_UART_FRAME_MAGIC_1)) {
			return 0;
		}
		first_seen = (byte == APP_UART_FRAME_MAGIC_0);
	}
}

static void write_bytes(const uint8_t *data, uint32_t size)
{
	for (uint32_t i = 0U; i < size; ++i) {
		uart_poll_out(uart_dev, data[i]);
	}
}

static int send_frame(enum app_uart_frame_type type, uint16_t sequence, const uint8_t *payload,
		      uint16_t length)
{
	uint8_t header[FRAME_HEADER_SIZE] = {
		APP_UART_FRAME_MAGIC_0,
		APP_UART_FRAME_MAGIC_1,
		APP_UART_PROTOCOL_VERSION,
		(uint8_t)type,
	};
	uint8_t encoded_crc[FRAME_CRC_SIZE];
	uint32_t crc;

	if ((length > FRAME_MAX_PAYLOAD_SIZE) || ((length != 0U) && (payload == NULL))) {
		return -EINVAL;
	}

	encode_le16(&header[4], sequence);
	encode_le16(&header[6], length);
	crc = app_protocol_frame_crc32(header, payload, length);
	encode_le32(encoded_crc, crc);

	write_bytes(header, sizeof(header));
	write_bytes(payload, length);
	write_bytes(encoded_crc, sizeof(encoded_crc));
	return 0;
}

static void send_ready(void)
{
	uint8_t capabilities[READY_PAYLOAD_SIZE];

	encode_le32(&capabilities[0], APP_MODEL_ID);
	encode_le16(&capabilities[4], APP_MODEL_INPUT_SIZE_BYTES);
	encode_le16(&capabilities[6], APP_MODEL_OUTPUT_SIZE_BYTES);
	capabilities[8] = APP_MODEL_INPUT_DTYPE;
	capabilities[9] = APP_MODEL_OUTPUT_DTYPE;
	encode_le16(&capabilities[10], APP_MODEL_CAPABILITY_FLAGS);
	(void)send_frame(APP_UART_FRAME_READY, 0U, capabilities, sizeof(capabilities));
}

int app_uart_init(void)
{
	return device_is_ready(uart_dev) ? 0 : -ENODEV;
}

int app_uart_receive_request(uint8_t *buffer, uint32_t size, struct app_uart_request *request)
{
	uint8_t header[FRAME_HEADER_SIZE] = {
		APP_UART_FRAME_MAGIC_0,
		APP_UART_FRAME_MAGIC_1,
	};
	uint8_t received_crc[FRAME_CRC_SIZE];
	uint8_t stale_byte;
	uint16_t payload_length;
	uint16_t frame_sequence = 0U;
	uint32_t start;
	enum app_uart_error_code validation_error;
	int ret;

	if ((buffer == NULL) || (request == NULL) || (size == 0U) ||
	    (size > FRAME_MAX_PAYLOAD_SIZE)) {
		return -EINVAL;
	}

	while (uart_poll_in(uart_dev, &stale_byte) == 0) {
	}
	(void)uart_err_check(uart_dev);
	send_ready();
	start = k_uptime_get_32();

	ret = read_magic(start);
	if (ret != 0) {
		if (ret == -EIO) {
			app_uart_send_error(0U, APP_UART_ERROR_TRANSPORT, ret);
		}
		return ret;
	}
	ret = read_exact(&header[2], FRAME_HEADER_SIZE - 2U, start, APP_UART_RX_TIMEOUT_MS);
	if (ret != 0) {
		app_uart_send_error(
			0U, ret == -EIO ? APP_UART_ERROR_TRANSPORT : APP_UART_ERROR_TIMEOUT, ret);
		return ret;
	}

	frame_sequence = decode_le16(&header[4]);
	request->sequence = frame_sequence;
	payload_length = decode_le16(&header[6]);
	validation_error =
		app_protocol_validate_request(header[2], header[3], payload_length, (uint16_t)size,
					      IS_ENABLED(CONFIG_APP_NPU_FAULT_INJECTION),
					      IS_ENABLED(CONFIG_APP_WATCHDOG_FAULT_INJECTION));
	if (validation_error != APP_UART_ERROR_NONE) {
		ret = validation_error == APP_UART_ERROR_LENGTH ? -EMSGSIZE : -EPROTO;
		app_uart_send_error(frame_sequence, validation_error, ret);
		return ret;
	}
	request->type = (enum app_uart_frame_type)header[3];

	ret = read_exact(buffer, payload_length, start, APP_UART_RX_TIMEOUT_MS);
	if (ret == 0) {
		ret = read_exact(received_crc, sizeof(received_crc), start, APP_UART_RX_TIMEOUT_MS);
	}
	if (ret != 0) {
		app_uart_send_error(frame_sequence,
				    ret == -EIO ? APP_UART_ERROR_TRANSPORT : APP_UART_ERROR_TIMEOUT,
				    ret);
		return ret;
	}

	if (decode_le32(received_crc) != app_protocol_frame_crc32(header, buffer, payload_length)) {
		app_uart_send_error(frame_sequence, APP_UART_ERROR_CRC, -EBADMSG);
		return -EBADMSG;
	}

	if ((request->type == APP_UART_FRAME_INFER_REQUEST) ||
	    (request->type == APP_UART_FRAME_NPU_STALL_REQUEST) ||
	    (request->type == APP_UART_FRAME_WATCHDOG_STALL_REQUEST)) {
		return send_frame(APP_UART_FRAME_ACK, frame_sequence, NULL, 0U);
	}
	return 0;
}

void app_uart_send_error(uint16_t sequence, enum app_uart_error_code code, int error)
{
	uint8_t payload[3];
	int16_t detail;

	if (error < INT16_MIN) {
		detail = INT16_MIN;
	} else if (error > INT16_MAX) {
		detail = INT16_MAX;
	} else {
		detail = (int16_t)error;
	}

	payload[0] = (uint8_t)code;
	encode_le16(&payload[1], (uint16_t)detail);
	(void)send_frame(APP_UART_FRAME_ERROR, sequence, payload, sizeof(payload));
}

int app_uart_send_result(uint16_t sequence, const uint8_t *result, uint32_t size,
			 const struct app_npu_metrics *metrics)
{
	uint8_t payload[RESULT_PAYLOAD_SIZE];

	if ((result == NULL) || (metrics == NULL) || (size != APP_MODEL_OUTPUT_SIZE_BYTES)) {
		return -EINVAL;
	}

	memcpy(payload, result, size);
	encode_le32(&payload[size], metrics->accelerator_us);
	encode_le32(&payload[size + 4U], metrics->runtime_us);
	encode_le32(&payload[size + 8U], metrics->total_us);
	encode_le32(&payload[size + 12U], metrics->npu_interrupts);
	encode_le32(&payload[size + 16U], metrics->npu_spurious_interrupts);
	return send_frame(APP_UART_FRAME_RESULT, sequence, payload, sizeof(payload));
}

int app_uart_send_clock_status(uint16_t sequence, const struct app_clock_status *status)
{
	uint8_t payload[CLOCK_STATUS_PAYLOAD_SIZE];
	const uint32_t values[CLOCK_STATUS_WORDS] = {
		status != NULL ? status->expected_mclk_hz : 0U,
		status != NULL ? status->derived_mclk_hz : 0U,
		status != NULL ? status->uart_clock_hz : 0U,
		status != NULL ? status->mclkcfg : 0U,
		status != NULL ? status->hsclken : 0U,
		status != NULL ? status->hsclkcfg : 0U,
		status != NULL ? status->pllcfg0 : 0U,
		status != NULL ? status->pllcfg1 : 0U,
		status != NULL ? status->genclken : 0U,
		status != NULL ? status->clkstatus : 0U,
		status != NULL ? status->flash_control : 0U,
		status != NULL ? status->validation_flags : 0U,
	};

	if (status == NULL) {
		return -EINVAL;
	}
	for (uint32_t i = 0U; i < CLOCK_STATUS_WORDS; ++i) {
		encode_le32(&payload[i * sizeof(uint32_t)], values[i]);
	}
	return send_frame(APP_UART_FRAME_CLOCK_STATUS, sequence, payload, sizeof(payload));
}

int app_uart_send_watchdog_status(uint16_t sequence, const struct app_watchdog_status *status)
{
	uint8_t payload[WATCHDOG_STATUS_PAYLOAD_SIZE];

	if (status == NULL) {
		return -EINVAL;
	}

	encode_le32(&payload[0], status->reset_cause);
	encode_le32(&payload[4], status->timeout_ms);
	encode_le32(&payload[8], status->running);
	return send_frame(APP_UART_FRAME_WATCHDOG_STATUS, sequence, payload, sizeof(payload));
}
```

## src/app_uart.h
```c
/* SPDX-License-Identifier: Apache-2.0 */

#ifndef APP_UART_H_
#define APP_UART_H_

#include <stdint.h>

#include "app_clock.h"
#include "app_npu.h"
#include "app_protocol.h"
#include "app_watchdog.h"

#define APP_UART_RX_TIMEOUT_MS 1000U

struct app_uart_request {
	enum app_uart_frame_type type;
	uint16_t sequence;
};

int app_uart_init(void);
int app_uart_receive_request(uint8_t *buffer, uint32_t size, struct app_uart_request *request);
void app_uart_send_error(uint16_t sequence, enum app_uart_error_code code, int error);
int app_uart_send_result(uint16_t sequence, const uint8_t *result, uint32_t size,
			 const struct app_npu_metrics *metrics);
int app_uart_send_clock_status(uint16_t sequence, const struct app_clock_status *status);
int app_uart_send_watchdog_status(uint16_t sequence, const struct app_watchdog_status *status);

#endif /* APP_UART_H_ */
```

## src/app_watchdog.c
```c
/* SPDX-License-Identifier: Apache-2.0 */

#include "app_watchdog.h"

#include <errno.h>
#include <stdbool.h>
#include <stddef.h>
#include <stdint.h>

#include <zephyr/devicetree.h>
#include <zephyr/kernel.h>
#include <zephyr/sys/sys_io.h>

#define WWDT_NODE   DT_NODELABEL(wwdt0)
#define SYSCTL_NODE DT_NODELABEL(sysctl)

#define WWDT_BASE   DT_REG_ADDR(WWDT_NODE)
#define SYSCTL_BASE DT_REG_ADDR_BY_NAME(SYSCTL_NODE, sysctl)

#define WWDT_PWREN_OFFSET  0x0800U
#define WWDT_RSTCTL_OFFSET 0x0804U
#define WWDT_STAT_OFFSET   0x0814U
#define WWDT_CTL0_OFFSET   0x1100U
#define WWDT_CTL1_OFFSET   0x1104U
#define WWDT_CNTRST_OFFSET 0x1108U
#define WWDT_STATUS_OFFSET 0x110CU
#define SYSCTL_SYSTEMCFG   0x1180U
#define SYSCTL_RSTCAUSE    0x1220U

#define WWDT_PWREN_KEY       0x26000000U
#define WWDT_RESET_KEY       0xB1000000U
#define WWDT_CTL0_KEY        0xC9000000U
#define WWDT_CTL1_KEY        0xBE000000U
#define SYSCTL_SYSTEMCFG_KEY 0x1B000000U

#define WWDT_POWER_ENABLE       BIT(0)
#define WWDT_RESET_ASSERT       BIT(0)
#define WWDT_RESET_STICKY_CLEAR BIT(1)
#define WWDT_RESET_STICKY       BIT(16)
#define WWDT_RUNNING            BIT(0)
#define SYSCTL_WWDT0_NMI        BIT(0)
#define SYSCTL_RESET_CAUSE_MASK 0x1FU
#define WWDT_RESTART_KEY        0xA7U

/* LFCLK / 4 * 2^15 = 4 seconds. Window 0 is open for the full period. */
#define WWDT_CLOCK_DIVIDE_BY_4 3U
#define WWDT_PERIOD_2_POW_15   0x30U
#define WWDT_CONTROL           (WWDT_CTL0_KEY | WWDT_CLOCK_DIVIDE_BY_4 | WWDT_PERIOD_2_POW_15)
#define WWDT_TIMEOUT_MS        4000U
#define WWDT_POWER_WAIT_US     1000U

static uint32_t boot_reset_cause;
static bool initialized;

static bool wait_for_mask(uintptr_t address, uint32_t mask, bool set)
{
	for (uint32_t elapsed = 0U; elapsed < WWDT_POWER_WAIT_US; ++elapsed) {
		if (((sys_read32(address) & mask) != 0U) == set) {
			return true;
		}
		k_busy_wait(1U);
	}
	return false;
}

int app_watchdog_init(void)
{
	uint32_t system_config;

	boot_reset_cause = sys_read32(SYSCTL_BASE + SYSCTL_RSTCAUSE) & SYSCTL_RESET_CAUSE_MASK;

	/* A WWDT0 violation must cause a BOOTRST, not merely an NMI. */
	system_config = sys_read32(SYSCTL_BASE + SYSCTL_SYSTEMCFG);
	system_config &= ~(0xFF000000U | SYSCTL_WWDT0_NMI);
	sys_write32(system_config | SYSCTL_SYSTEMCFG_KEY, SYSCTL_BASE + SYSCTL_SYSTEMCFG);

	/* Match TI driverlib: reset, power, wait for power, then configure once. */
	sys_write32(WWDT_RESET_KEY | WWDT_RESET_STICKY_CLEAR | WWDT_RESET_ASSERT,
		    WWDT_BASE + WWDT_RSTCTL_OFFSET);
	sys_write32(WWDT_PWREN_KEY | WWDT_POWER_ENABLE, WWDT_BASE + WWDT_PWREN_OFFSET);
	if (!wait_for_mask(WWDT_BASE + WWDT_PWREN_OFFSET, WWDT_POWER_ENABLE, true) ||
	    !wait_for_mask(WWDT_BASE + WWDT_STAT_OFFSET, WWDT_RESET_STICKY, true)) {
		return -EIO;
	}

	sys_write32(WWDT_CONTROL, WWDT_BASE + WWDT_CTL0_OFFSET);
	sys_write32(WWDT_CTL1_KEY, WWDT_BASE + WWDT_CTL1_OFFSET);
	if (!wait_for_mask(WWDT_BASE + WWDT_STATUS_OFFSET, WWDT_RUNNING, true)) {
		return -EIO;
	}

	initialized = true;
	return 0;
}

int app_watchdog_feed(void)
{
	if (!initialized) {
		return -EFAULT;
	}

	sys_write32(WWDT_RESTART_KEY, WWDT_BASE + WWDT_CNTRST_OFFSET);
	return 0;
}

void app_watchdog_read_status(struct app_watchdog_status *status)
{
	if (status == NULL) {
		return;
	}

	status->reset_cause = boot_reset_cause;
	status->timeout_ms = WWDT_TIMEOUT_MS;
	status->running = sys_read32(WWDT_BASE + WWDT_STATUS_OFFSET) & WWDT_RUNNING;
}

void app_watchdog_test_stall(void)
{
	/* Deliberately withhold the only feed source. WWDT0 must reset the board. */
	for (;;) {
		k_cpu_idle();
	}
}
```

## src/app_watchdog.h
```c
/* SPDX-License-Identifier: Apache-2.0 */

#ifndef APP_WATCHDOG_H_
#define APP_WATCHDOG_H_

#include <stdint.h>

#define APP_WATCHDOG_RESET_CAUSE_WWDT0 0x0EU

struct app_watchdog_status {
	uint32_t reset_cause;
	uint32_t timeout_ms;
	uint32_t running;
};

int app_watchdog_init(void);
int app_watchdog_feed(void);
void app_watchdog_read_status(struct app_watchdog_status *status);
void app_watchdog_test_stall(void);

#endif /* APP_WATCHDOG_H_ */
```
