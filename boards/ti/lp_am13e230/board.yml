## boards/ti/lp_am13e230/board.yml
```yaml
board:
  name: lp_am13e230
  full_name: AM13E230 LaunchPad
  vendor: ti
  socs:
    - name: am13e23019
```

## drivers/Kconfig
```kconfig
# SPDX-License-Identifier: Apache-2.0

rsource "misc/Kconfig"
rsource "pinctrl/Kconfig"
rsource "serial/Kconfig"
```

## drivers/misc/tinyengine/Kconfig
```kconfig
# SPDX-License-Identifier: Apache-2.0

config TINYENGINE_AM13E230X
	bool "TI AM13E230x TINIElite NPU support"
	default y
	depends on DT_HAS_TI_AM13E230X_TINYENGINE_ENABLED
	help
	  Enable the low-level adapter used by TI's generated TINIElite model
	  archive. Hardware completion is acknowledged by the driver ISR and
	  delivered to thread context through a semaphore.

config TINYENGINE_LOG_LEVEL
	int "TINIElite driver log level"
	range 0 4
	default 3
	depends on TINYENGINE_AM13E230X
```

## drivers/pinctrl/Kconfig
```kconfig
# SPDX-License-Identifier: Apache-2.0

config PINCTRL_AM13E230X
	bool "TI AM13E230x pin controller"
	default y
	depends on PINCTRL && DT_HAS_TI_AM13E230X_PINCTRL_ENABLED
	help
	  Enable pin routing through the AM13E230x IOMUX PINCM registers.
```

## drivers/serial/Kconfig
```kconfig
# SPDX-License-Identifier: Apache-2.0

config UART_AM13E230X
	bool "TI AM13E230x UNICOMM UART polling driver"
	default y
	depends on DT_HAS_TI_AM13E230X_UNICOMM_UART_ENABLED
	select SERIAL_HAS_DRIVER
	help
	  Enable polling-mode UART support for the AM13E230x UNICOMM block.
	  Interrupt-driven and asynchronous UART APIs are not implemented.
```

## dts/bindings/clock/ti,am13e230x-sysctl.yaml
```yaml
description: TI AM13E230x system clock controller telemetry

compatible: "ti,am13e230x-sysctl"

include: base.yaml

properties:
  reg:
    required: true

  reg-names:
    required: true

  ti,hfclk-frequency:
    type: int
    required: true
    description: External crystal or digital HFCLK input frequency in hertz

  ti,sysosc-frequency:
    type: int
    required: true
    description: Nominal SYSOSC frequency in hertz
```

## dts/bindings/misc/ti,am13e230x-tinyengine.yaml
```yaml
# Copyright (c) 2024
# SPDX-License-Identifier: Apache-2.0

description: TI AM13E230x TINIElite neural processing unit

compatible: "ti,am13e230x-tinyengine"

include: base.yaml

properties:
  reg:
    required: true

  reg-names:
    required: true

  interrupts:
    required: true
```

## dts/bindings/pinctrl/ti,am13e230x-pinctrl.yaml
```yaml
# SPDX-License-Identifier: Apache-2.0

description: TI AM13E230x pin controller

compatible: "ti,am13e230x-pinctrl"

include: base.yaml

properties:
  reg:
    required: true

child-binding:
  include:
    - name: pincfg-node.yaml
      property-allowlist:
        - bias-disable
        - bias-pull-down
        - bias-pull-up
        - input-enable

  properties:
    pinmux:
      type: array
      required: true
      description: PINCM index followed by the peripheral function number
```

## dts/bindings/serial/ti,am13e230x-unicomm-uart.yaml
```yaml
# SPDX-License-Identifier: Apache-2.0

description: TI AM13E230x UNICOMM UART

compatible: "ti,am13e230x-unicomm-uart"

include: [uart-controller.yaml, pinctrl-device.yaml]

properties:
  reg:
    required: true

  reg-names:
    required: true

  clocks:
    required: true

  current-speed:
    required: true
```

## dts/bindings/watchdog/ti,am13e230x-wwdt.yaml
```yaml
# SPDX-License-Identifier: Apache-2.0

description: TI AM13E230x window watchdog timer

compatible: "ti,am13e230x-wwdt"

include: base.yaml

properties:
  reg:
    required: true

  clock-frequency:
    type: int
    required: true
    const: 32768
    description: Fixed low-frequency watchdog clock in hertz
```

## soc/ti/am13x/Kconfig
```kconfig
# SPDX-License-Identifier: Apache-2.0

config SOC_SERIES_AM13X
	bool

config SOC_SERIES
	default "am13x" if SOC_SERIES_AM13X

rsource "Kconfig.soc"
```

## soc/ti/am13x/Kconfig.defconfig
```kconfig
# SPDX-License-Identifier: Apache-2.0

if SOC_SERIES_AM13X

config NUM_IRQS
	default 48

config SYS_CLOCK_HW_CYCLES_PER_SEC
	default 200000000

endif
```

## soc/ti/am13x/Kconfig.soc
```kconfig
# SPDX-License-Identifier: Apache-2.0

config SOC_SERIES_AM13X
	bool
	select ARM
	select CPU_CORTEX_M33
	select CPU_CORTEX_M_HAS_DWT
	select CPU_HAS_FPU
	select CPU_HAS_ARM_MPU
	select ARM_MPU
	select ARMV8_M_DSP
	select FPU

config SOC_AM13E23019
	bool
	select SOC_SERIES_AM13X

config SOC
	default "am13e23019" if SOC_AM13E23019
```

## tests/protocol/testcase.yaml
```yaml
tests:
  app.protocol:
    platform_allow:
      - native_sim
    integration_platforms:
      - native_sim
    tags:
      - protocol
      - unit
```

## west.yml
```yaml
manifest:
  remotes:
    - name: zephyrproject
      url-base: https://github.com/zephyrproject-rtos

  projects:
    - name: zephyr
      remote: zephyrproject
      revision: 9574b65fbaa01aa0c8f418bd7a6b97beb15fcc54
      import:
        name-allowlist:
          - cmsis
          - cmsis_6

  self:
    path: am13e230-tinielite-zephyr
```
